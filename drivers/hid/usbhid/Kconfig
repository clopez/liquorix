## drivers/hid/usbhid/Kconfig
```kconfig
comment "USB Input Devices"
	depends on USB

config USB_HID
	tristate "USB Human Interface Device (full HID) support"
	default y
	depends on USB && INPUT
	select HID
	---help---
	  Say Y here if you want full HID support to connect USB keyboards,
	  mice, joysticks, graphic tablets, or any other HID based devices
	  to your computer via USB, as well as Uninterruptible Power Supply
	  (UPS) and monitor control devices.

	  You can't use this driver and the HIDBP (Boot Protocol) keyboard
	  and mouse drivers at the same time. More information is available:
	  <file:Documentation/input/input.txt>.

	  If unsure, say Y.

	  To compile this driver as a module, choose M here: the
	  module will be called usbhid.

config USB_HID_MOUSE_POLLING
	bool "USB HID Mouse Interrupt Polling"
	default n
	depends on USB_HID
	help
	 This option enables USB HID mouse polling instead of an event
	 based system.  This option is only recommended for badly designed
	 USB chipsets.

	 If unsure, say N.

config USB_HID_MOUSE_POLLING_INTERVAL
	int "USB HID Mouse Interrupt Polling Interval"
	default 10
	depends on USB_HID_MOUSE_POLLING
	help
	  The "USB HID Mouse Interrupt Polling Interval" is the interval, at
	  which your USB HID mouse is to be polled at. The interval is
	  specified in milliseconds.

	  Decreasing the interval will, of course, give you a much more
	  precise mouse.

	  Generally speaking, a polling interval of 2 ms should be more than
	  enough for most people, and is great for gaming and other things
	  that require high precision.

	  An interval lower than 10ms is not guaranteed work on your
	  specific piece of hardware. If you want to play it safe, don't
	  change this value.

	  Now, if you indeed want to feel the joy of a precise mouse, the
	  following mice are known to work without problems, when the interval
	  is set to at least 2 ms:

	    * Logitech's MX-family
	    * Logitech Mouse Man Dual Optical
	    * Logitech iFeel
	    * Microsoft Intellimouse Explorer
	    * Microsoft Intellimouse Optical 1.1

	  If unsure, keep it at 10 ms.

comment "Input core support is needed for USB HID input layer or HIDBP support"
	depends on USB_HID && INPUT=n

config HID_PID
	bool "PID device support"
	help
	  Say Y here if you have a PID-compliant device and wish to enable force
	  feedback for it. Microsoft Sidewinder Force Feedback 2 is one of such
	  devices.

config USB_HIDDEV
	bool "/dev/hiddev raw HID device support"
	depends on USB_HID
	help
	  Say Y here if you want to support HID devices (from the USB
	  specification standpoint) that aren't strictly user interface
	  devices, like monitor controls and Uninterruptable Power Supplies.

	  This module supports these devices separately using a separate
	  event interface on /dev/usb/hiddevX (char 180:96 to 180:111).

	  If unsure, say Y.

menu "USB HID Boot Protocol drivers"
	depends on USB!=n && USB_HID!=y && EMBEDDED

config USB_KBD
	tristate "USB HIDBP Keyboard (simple Boot) support"
	depends on USB && INPUT
	---help---
	  Say Y here only if you are absolutely sure that you don't want
	  to use the generic HID driver for your USB keyboard and prefer
	  to use the keyboard in its limited Boot Protocol mode instead.

	  This is almost certainly not what you want.  This is mostly
	  useful for embedded applications or simple keyboards.

	  To compile this driver as a module, choose M here: the
	  module will be called usbkbd.

	  If even remotely unsure, say N.

config USB_MOUSE
	tristate "USB HIDBP Mouse (simple Boot) support"
	depends on USB && INPUT
	---help---
	  Say Y here only if you are absolutely sure that you don't want
	  to use the generic HID driver for your USB mouse and prefer
	  to use the mouse in its limited Boot Protocol mode instead.

	  This is almost certainly not what you want.  This is mostly
	  useful for embedded applications or simple mice.

	  To compile this driver as a module, choose M here: the
	  module will be called usbmouse.

	  If even remotely unsure, say N.

endmenu
```

## drivers/input/lirc/Kconfig
```kconfig
#
# LIRC driver(s) configuration
#
menuconfig INPUT_LIRC
	tristate "Linux Infrared Remote Control IR receiver/transmitter drivers"
	help
	  Say Y here, and all supported Linux Infrared Remote Control IR and
	  RF receiver and transmitter drivers will be displayed. When paired
	  with a remote control and the lirc daemon, the receiver drivers
	  allow control of your Linux system via remote control.

if INPUT_LIRC

config LIRC_BT829
        tristate "BT829 based hardware"
	depends on INPUT_LIRC
	help
	  Driver for the IR interface on BT829-based hardware

config LIRC_ENE0100
	tristate "ENE KB3924/ENE0100 CIR Port Reciever"
	depends on INPUT_LIRC
	help
	  This is a driver for CIR port handled by ENE KB3924 embedded
	  controller found on some notebooks.
	  It appears on PNP list as ENE0100.

config LIRC_I2C
	tristate "I2C Based IR Receivers"
	depends on INPUT_LIRC
	help
	  Driver for I2C-based IR receivers, such as those commonly
	  found onboard Hauppauge PVR-150/250/350 video capture cards

config LIRC_IGORPLUGUSB
	tristate "Igor Cesko's USB IR Receiver"
	depends on INPUT_LIRC && USB
	help
	  Driver for Igor Cesko's USB IR Receiver

config LIRC_IMON
	tristate "SoundGraph iMON Receiver and Display"
	depends on INPUT_LIRC
	help
	  Driver for the SoundGraph iMON IR Receiver and Display

config LIRC_IT87
	tristate "ITE IT87XX CIR Port Receiver"
	depends on INPUT_LIRC
	help
	  Driver for the ITE IT87xx IR Receiver

config LIRC_ITE8709
	tristate "ITE8709 CIR Port Receiver"
	depends on INPUT_LIRC && PNP
	help
	  Driver for the ITE8709 IR Receiver

config LIRC_MCEUSB
	tristate "Windows Media Center Ed. USB IR Transceiver"
	depends on INPUT_LIRC && USB
	help
	  Driver for Windows Media Center Ed. USB IR Transceivers

config LIRC_PARALLEL
	tristate "Homebrew Parallel Port Receiver"
	depends on INPUT_LIRC && !SMP
	help
	  Driver for Homebrew Parallel Port Receivers

config LIRC_SASEM
	tristate "Sasem USB IR Remote"
	depends on INPUT_LIRC
	help
	  Driver for the Sasem OnAir Remocon-V or Dign HV5 HTPC IR/VFD Module

config LIRC_SERIAL
	tristate "Homebrew Serial Port Receiver"
	depends on INPUT_LIRC
	help
	  Driver for Homebrew Serial Port Receivers

config LIRC_SERIAL_TRANSMITTER
	bool "Serial Port Transmitter"
	default y
	depends on LIRC_SERIAL
	help
	  Serial Port Transmitter support

config LIRC_SIR
	tristate "Built-in SIR IrDA port"
	depends on INPUT_LIRC
	help
	  Driver for the SIR IrDA port

config LIRC_STREAMZAP
	tristate "Streamzap PC Receiver"
	depends on INPUT_LIRC
	help
	  Driver for the Streamzap PC Receiver

config LIRC_TTUSBIR
	tristate "Technotrend USB IR Receiver"
	depends on INPUT_LIRC && USB
	help
	  Driver for the Technotrend USB IR Receiver

config LIRC_ZILOG
	tristate "Zilog/Hauppauge IR Transmitter"
	depends on INPUT_LIRC
	help
	  Driver for the Zilog/Hauppauge IR Transmitter, found on
	  PVR-150/500, HVR-1200/1250/1700/1800, HD-PVR and other cards
endif
```

## fs/dazukofs/Kconfig
```kconfig
config DAZUKOFS_FS
	tristate "DazukoFS filesystem layer support (EXPERIMENTAL)"
	depends on EXPERIMENTAL
	help
	  A stackable filesystem to allow userspace applications to perform
	  online file access control.
	  See <file:Documentation/filesystems/dazukofs.txt> to learn more
	  about DazukoFS.

	  To compile this file system support as a module, choose M here: the
	  module will be called dazukofs.
```
